## conf/machine/beaglebone-rt.conf
```bitbake
#@TYPE: Machine
#@NAME: Beaglebone
#@DESCRIPTION: Machine configuration for the Beaglebone

SOC_FAMILY = "ti335x"
TARGET_ARCH = "arm"

#KERNEL_DEIVCETREE:append = "am335x-boneblack-custom.dtb"
```
