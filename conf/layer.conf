## conf/layer.conf
```bitbake
# We have a conf and classes directory, add to BBPATH
BBPATH .= ":${LAYERDIR}"

# We have recipes-* directories, add to BBFILES
BBFILES += "${LAYERDIR}/recipes-*/*/*.bb \
            ${LAYERDIR}/recipes-*/*/*.bbappend"

BBFILE_COLLECTIONS += "meta-beaglebone-rt"
BBFILE_PATTERN_meta-beaglebone-rt = "^${LAYERDIR}/"
BBFILE_PRIORITY_meta-beaglebone-rt = "6"

LAYERDEPENDS_meta-beaglebone-rt = "core"
LAYERSERIES_COMPAT_meta-beaglebone-rt = "dunfell"
```
